## firmware/app/boards/discyboi/discyboi/Kconfig.discyboi
```kconfig
config BOARD_DISCYBOI
	select SOC_NRF54L15_CPUAPP if BOARD_DISCYBOI_NRF54L15_CPUAPP
```

## firmware/app/boards/discyboi/discyboi/board.yml
```yaml
board:
  name: discyboi
  full_name: discyboi v4 (Fanstel BC15M / nRF54L15)
  vendor: discyboi
  socs:
    - name: nrf54l15
```
